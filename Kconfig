## Kconfig
```kconfig
mainmenu "Xen-on-ARM configuration"

menu "Target Architecture"
choice
	prompt "Select target architecture"

config ARCH_X86
	bool "Support of x86 architecture"

config ARCH_ARM
	bool "Support of ARM architecture"
endchoice

endmenu

source "arch/arm/Kconfig"

menu "General Setup"
config OPTIMIZE_FOR_SIZE
	bool "Optimize for size"

endmenu

source "common/Kconfig"
```

## arch/arm/Kconfig
```kconfig
mainmenu "Xen-on-ARM configuration"

config ARM
	bool
	default y

menu "General Setup"
config OPTIMIZE_FOR_SIZE
	bool "Optimize for size"
config EABI_SUPPORT
	bool "Use AEM EABI to compile the Xen/ARM"
endmenu

menu "System Type"

config CPU_ISA_32V5
	bool

config CPU_TLB_V4WBI
	bool

config CPU_COPYPAGE_V4WB
	bool

config RAM_START_ZERO
	bool

config CPU_ARM926T
	bool
	select CPU_ISA_32V5
	select CPU_TLB_V4WBI
	select CPU_COPYPAGE_V4WB

config MACHINE_IMX21
	bool
	select CPU_ARM926T

config MACHINE_GOLDFISH
	bool
	select CPU_ARM926T
	select RAM_START_ZERO

config MACHINE_VERSATILE
	bool
	select CPU_ARM926T
	select RAM_START_ZERO

config MACHINE_REALVIEW
	bool
	select CPU_ARM926T
	select RAM_START_ZERO

choice
	prompt "Select target platform"

source "arch/arm/arch-imx21/Kconfig"

source "arch/arm/arch-goldfish/Kconfig"

source "arch/arm/arch-versatile/Kconfig"

source "arch/arm/arch-realview/Kconfig"
endchoice

endmenu

menu "Customize Memory Map"
config HYPERVISOR_BASE
	hex "Hypervisor virtual address"
	default 0xFF000000

        menu "Domain Memory Size"
        config MEMMAP_GUEST_0_SIZE
                hex "domain0 memory size (including xen memory size : 2MB)"
                default 0x02000000

        config MEMMAP_GUEST_1_SIZE
                hex "domain1 memory size"
                default 0x01000000

        config MEMMAP_GUEST_2_SIZE
                hex "domain2 memory size"
                default 0x01000000

        config MEMMAP_GUEST_3_SIZE
                hex "domain3 memory size"
                default 0x00000000
        endmenu

        menu "Image Max Size"
        config MEMMAP_GUEST_0_ELF_MAX_SIZE
                hex "domain0 image max size"
                default 0x00400000

        config MEMMAP_GUEST_1_ELF_MAX_SIZE
                hex "domain1 image max size"
                default 0x00400000

        config MEMMAP_GUEST_2_ELF_MAX_SIZE
                hex "domain2 image max size"
                default 0x00400000

        config MEMMAP_GUEST_3_ELF_MAX_SIZE
                hex "domain3 image max size"
                default 0x00400000
        endmenu

        menu "Ram Disk Size"
        config MEMMAP_GUEST_0_RAMDISK_SIZE
                hex "domain0 ramdisk size"
                default 0x00400000

        config MEMMAP_GUEST_1_RAMDISK_SIZE
                hex "domain1 ramdisk size"
                default 0x00400000

        config MEMMAP_GUEST_2_RAMDISK_SIZE
                hex "domain2 ramdisk size"
                default 0x00400000

        config MEMMAP_GUEST_3_RAMDISK_SIZE
                hex "domain3 ramdisk size"
                default 0x00400000
        endmenu
endmenu

source "security/Kconfig"

source "common/Kconfig"
```

## arch/arm/arch-goldfish/Kconfig
```kconfig
config PLATFORM_GOLDFISH
    bool "Android emulator board(Goldfish)"
    select MACHINE_GOLDFISH
    help
        Say Y here if you are using the Android emulator board called goldfish.
```

## arch/arm/arch-realview/Kconfig
```kconfig
config PLATFORM_REALVIEWEB
	bool "ARM realview_eb"
	select MACHINE_REALVIEW
	help
		Say Y here if you are using the ARM realview EB 
```

## arch/arm/arch-versatile/Kconfig
```kconfig
config PLATFORM_VERSATILEPB
	bool "ARM versatile_pb"
	select MACHINE_VERSATILE 
	help
		Say Y here if you are using the ARM versatile PB 
```
